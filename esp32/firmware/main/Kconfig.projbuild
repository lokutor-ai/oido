## esp32/firmware/main/Kconfig.projbuild
```kconfig
menu "tinyasr"
    choice TASR_MODE
        prompt "Input source"
        default TASR_MODE_FILE
        config TASR_MODE_FILE
            bool "Benchmark: utterances stored in the 'audio' partition"
        config TASR_MODE_MIC
            bool "Live: I2S MEMS microphone (e.g. INMP441)"
    endchoice
    config TASR_I2S_BCLK
        int "I2S BCLK (SCK) GPIO"
        default 4
    config TASR_I2S_WS
        int "I2S WS (LRCL) GPIO"
        default 5
    config TASR_I2S_DIN
        int "I2S data-in (SD) GPIO"
        default 6
    config TASR_SEG_HANG_MS
        int "Pause (ms) that ends an utterance in microphone mode"
        default 800
        help
            Silence after speech before the utterance is closed and its final text printed. With a streaming
            model almost all compute is done by then, so this pause is most of the latency; voice agents
            typically use 400-600 ms (or their own turn detector).
    config TASR_BENCH_PACED
        bool "File mode: also stream every clip at real-time pace and report when the final text appears"
        default n
        help
            Benchmark builds only. The clip is fed in 20 ms blocks, each one when its last sample would have been
            spoken, so the delay of the final text after the end of speech includes any backlog if the chip is slower
            than real time.

    config TASR_STREAM_ONLY
        bool "File-mode benchmark: streaming pass only, streaming state first, weights get the rest of PSRAM"
        default n

    config TASR_PSRAM_RESERVE_KB
        int "Stream-only benchmark: PSRAM (KB) kept free after the weights are placed (900 = what the live-microphone mode needs for the ring and the 20 s recording buffer)"
        default 300
        depends on TASR_STREAM_ONLY

    config TASR_BENCH_REPEAT
        int "Paced benchmark: feed each clip this many times in a row into one stream (long-utterance test)"
        default 1
        range 1 64
        depends on TASR_BENCH_PACED

    config TASR_EXP_NO_WPF
        bool "Experiment: no weight preload into the D-cache (kernels.c tasr_wpf = 0)"
        default n

    config TASR_EXP_NO_PSRAM_WEIGHTS
        bool "Experiment: keep all weights in flash (no copies in PSRAM)"
        default n

    config TASR_EXP_SPIN_PARFOR
        bool "Experiment: two-core parallel-for with spin-waiting instead of FreeRTOS semaphores"
        default n

    config TASR_EXP_NOINT
        bool "Experiment (with spin-wait): interrupts masked on both cores while a job runs"
        depends on TASR_EXP_SPIN_PARFOR
        default n

    config TASR_PAR_MASK
        int "Experiment: bit mask of the parallel call sites that use both cores (0 gives all-serial); unset = all"
        default 511
        depends on TASR_EXP_PAR_MASK_ON

    config TASR_EXP_PAR_MASK_ON
        bool "Experiment: enable TASR_PAR_MASK"
        default n

    config TASR_EXP_XQ_COPY
        bool "Experiment: worker 1 reads a private copy of the activation tile in the K=704 GEMMs"
        default n

    config TASR_EXP_XQ_PSRAM
        bool "Experiment: activation tile in PSRAM instead of internal SRAM"
        default n

    config TASR_EXP_DOT_DUP
        bool "Experiment: each core runs its own copy of the dot-product kernel"
        default n

    config TASR_EXP_DOT_IRAM
        bool "Experiment: dot-product kernel in IRAM"
        default n

    config TASR_EXP_ROWSPLIT
        bool "Experiment: split the K=704 matrix products over rows instead of output channels"
        default n

    config TASR_OLED
        bool "SSD1306 128x64 I2C OLED showing the live transcript"
        default n
    config TASR_OLED_SDA
        int "OLED SDA GPIO"
        default 8
        depends on TASR_OLED
    config TASR_OLED_SCL
        int "OLED SCL GPIO"
        default 9
        depends on TASR_OLED
    config TASR_OLED_ADDR
        hex "OLED I2C address"
        default 0x3C
        depends on TASR_OLED
    config TASR_CHUNK
        int "Encoder chunk (25 Hz frames, even); 32 = 1.28 s"
        default 32
    config TASR_LEFT
        int "Attention history in chunks"
        default 2
    config TASR_BEAM
        int "Beam width when an LM partition is present"
        default 4
    config TASR_STREAM_CHUNK
        int "Streaming chunk in encoder frames (0 = the model's default: 8 x 80 ms for v2 models, 16 x 40 ms for v1)"
        default 0
    config TASR_STREAM_LEFT
        int "Streaming left context in encoder frames (0 = the model's default)"
        default 0
    config TASR_TOPK
        int "Candidate tokens per frame for the NeMo CTC beam search (6 = published setting; 3 costs ~0.1-0.2 WER and runs ~4x fewer LM steps with beam 2)"
        default 6
    config TASR_LM_WEIGHT_X100
        int "LM weight x100"
        default 60
    config TASR_TOKEN_BONUS_X100
        int "Token insertion bonus x100"
        default 250
endmenu
```

## esp32/tools/gemm_bench/sdkconfig.defaults
```kconfig
CONFIG_IDF_TARGET="esp32s3"
CONFIG_ESPTOOLPY_FLASHSIZE_16MB=y
CONFIG_ESPTOOLPY_FLASHMODE_QIO=y
CONFIG_ESPTOOLPY_FLASHFREQ_80M=y
CONFIG_PARTITION_TABLE_CUSTOM=y
CONFIG_PARTITION_TABLE_CUSTOM_FILENAME="../../firmware/partitions_nemo16lm.csv"
CONFIG_SPIRAM=y
CONFIG_SPIRAM_MODE_OCT=y
CONFIG_SPIRAM_SPEED_80M=y
CONFIG_SPIRAM_USE_CAPS_ALLOC=y
CONFIG_ESP_DEFAULT_CPU_FREQ_MHZ_240=y
CONFIG_COMPILER_OPTIMIZATION_PERF=y
CONFIG_ESP_MAIN_TASK_STACK_SIZE=16384
CONFIG_ESP32S3_DATA_CACHE_64KB=y
CONFIG_ESP32S3_DATA_CACHE_LINE_64B=y
CONFIG_ESP32S3_INSTRUCTION_CACHE_32KB=y
CONFIG_ESP_TASK_WDT_EN=n
CONFIG_ESP_INT_WDT=n
CONFIG_FREERTOS_HZ=1000
```
